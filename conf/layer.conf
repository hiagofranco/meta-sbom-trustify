## conf/layer.conf
```bitbake
# We have a conf and classes directory, add to BBPATH
BBPATH .= ":${LAYERDIR}"

# We have recipes-* directories, add to BBFILES
BBFILES += "${LAYERDIR}/recipes-*/*/*.bb \
            ${LAYERDIR}/recipes-*/*/*.bbappend"

BBFILE_COLLECTIONS += "meta-sbom-trustify"
BBFILE_PATTERN_meta-sbom-trustify = "^${LAYERDIR}/"
BBFILE_PRIORITY_meta-sbom-trustify = "6"

LAYERDEPENDS_meta-sbom-trustify = "core"
LAYERSERIES_COMPAT_meta-sbom-trustify = "scarthgap"
```
